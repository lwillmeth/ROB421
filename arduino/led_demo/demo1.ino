#include "FastLED.h"

#define NUM_LEDS 25
#define DATA_PIN 2

// Define the array of leds
CRGB leds[NUM_LEDS];

int simpleNumbers[][26]{
  {22, 0,1,2,3,4,5,6,7,8,9,10,11,12,13,14,15,16,17,18,19,20,21},
  {8,  0,1,2,3,4,5,6,7},
  {17, 0,1,2,3,8,9,10,11,12,13,14,19,20,21,22,23,24},
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  {18, 0,1,2,3,4,5,6,7,15,16,17,18,19,20,21,22,23,24}
};

int smallDigit[][19]{
  {16, 0,1,2,3,4,5,6,7,8,9,10,11,12,13,14,15},
  {6,  0,1,2,3,4,5},
  {12, 0,1,2,6,7,8,9,10,14,15,16,17},
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  {13, 0,1,2,3,4,5,11,12,13,14,15,16,17}
};

void setup() {
  Serial.begin(115200);
  FastLED.addLeds<NEOPIXEL, DATA_PIN>(leds, NUM_LEDS);
}

void loop() {
  digitalWrite(LED_BUILTIN, HIGH);
  for(int digit=0; digit<10; digit++){
    Serial.println(digit);
    for(int i=1; i <= smallDigit[digit][0]; i++){
      Serial.print("\t");
      Serial.println(smallDigit[digit][i]);
      leds[smallDigit[digit][i]] = CRGB::Red;
    }
    FastLED.show();
    for(int i=0; i<NUM_LEDS; i++){
      leds[i] = CRGB::Black;
    }
    delay(500);
    digitalWrite(LED_BUILTIN, LOW);
  }
}
